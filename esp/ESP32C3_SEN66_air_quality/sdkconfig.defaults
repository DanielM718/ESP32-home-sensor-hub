## esp/ESP32C3_SEN66_air_quality/sdkconfig.defaults
```kconfig
CONFIG_IDF_TARGET="esp32c3"

# Seeed XIAO ESP32-C3 has 4 MB flash. Keep this explicit so fresh ESP-IDF
# builds do not default to a smaller 2 MB flash image.
# CONFIG_ESPTOOLPY_FLASHSIZE_2MB is not set
CONFIG_ESPTOOLPY_FLASHSIZE_4MB=y
CONFIG_ESPTOOLPY_FLASHSIZE="4MB"

# Wi-Fi/MQTT pulls in enough code that the default 1 MB app partition leaves
# little growth room. The ESP-IDF large single-app partition is 1.5 MB and still
# avoids adding a project-specific partition CSV.
# CONFIG_PARTITION_TABLE_SINGLE_APP is not set
CONFIG_PARTITION_TABLE_SINGLE_APP_LARGE=y
CONFIG_PARTITION_TABLE_FILENAME="partitions_singleapp_large.csv"
```
